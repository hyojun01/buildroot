## package/rte-control/Config.in
```kconfig
config BR2_PACKAGE_RTE_CONTROL
	bool "rte-control"
	depends on BR2_USE_MMU
	depends on BR2_TOOLCHAIN_HAS_THREADS
	select BR2_PACKAGE_LIBIIO
	select BR2_PACKAGE_LIBIIO_LOCAL_BACKEND
	select BR2_PACKAGE_MONGOOSE
	help
	  Semantic radar target emulator control daemon and diagnostic tool.
	  The daemon owns the local AD936x PHY and the MathWorks MWIPCORE
	  AXI4-Lite character device.

comment "rte-control needs a toolchain with threads"
	depends on BR2_USE_MMU
	depends on !BR2_TOOLCHAIN_HAS_THREADS
```
